/*
 * RT-22 v0.2 Custom Pinout Override
 * 
 * RT-22 has completely different pin assignment compared to standard Corne!
 * Standard Corne: Rows on D4,C6,D7,E6 and Cols on F6,F7,B1,B3,B2,B6
 * RT-22 v0.2:     Rows on F6,F7,B1,B3 and Cols on SDA,D4,C6,D7,E6 (5 columns)
 *
 * The keymap uses 6-column layout with &none on outer columns.
 * We map Col0 to B2 (unused pin, floating) to maintain matrix compatibility.
 *
 * RT-22 Pinout (Left Half):
 *   Row0 (QWERT row):  F6  = pro_micro 21
 *   Row1 (ASDFG row):  F7  = pro_micro 20
 *   Row2 (ZXCVB row):  B1  = pro_micro 19
 *   Row3 (Thumb row):  B3  = pro_micro 18
 *
 *   Col0 (unused, &none):       B2  = pro_micro 15 (floating/dummy)
 *   Col1 (Q-A-Z):               SDA = pro_micro 2
 *   Col2 (W-S-X):               D4  = pro_micro 4
 *   Col3 (E-D-C + inner thumb): C6  = pro_micro 5
 *   Col4 (R-F-V + mid thumb):   D7  = pro_micro 6
 *   Col5 (T-G-B + outer thumb): E6  = pro_micro 7
 */

/* Override the default Corne kscan configuration */
&kscan0 {
    row-gpios
        = <&pro_micro 21 (GPIO_ACTIVE_HIGH | GPIO_PULL_DOWN)>  /* F6 - Row0 */
        , <&pro_micro 20 (GPIO_ACTIVE_HIGH | GPIO_PULL_DOWN)>  /* F7 - Row1 */
        , <&pro_micro 19 (GPIO_ACTIVE_HIGH | GPIO_PULL_DOWN)>  /* B1 - Row2 */
        , <&pro_micro 18 (GPIO_ACTIVE_HIGH | GPIO_PULL_DOWN)>  /* B3 - Row3 */
        ;

    col-gpios
        = <&pro_micro 15 GPIO_ACTIVE_HIGH>  /* B2  - Col0 (dummy, keymap has &none here) */
        , <&pro_micro 2 GPIO_ACTIVE_HIGH>   /* SDA - Col1 (Q-A-Z) */
        , <&pro_micro 4 GPIO_ACTIVE_HIGH>   /* D4  - Col2 (W-S-X) */
        , <&pro_micro 5 GPIO_ACTIVE_HIGH>   /* C6  - Col3 (E-D-C + inner thumb) */
        , <&pro_micro 6 GPIO_ACTIVE_HIGH>   /* D7  - Col4 (R-F-V + middle thumb) */
        , <&pro_micro 7 GPIO_ACTIVE_HIGH>   /* E6  - Col5 (T-G-B + outer thumb) */
        ;
};
