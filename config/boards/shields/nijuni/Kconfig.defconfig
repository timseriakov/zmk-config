## config/boards/shields/nijuni/Kconfig.shield
```kconfig
config SHIELD_NIJUNI
    bool

config SHIELD_NIJUNI_LEFT
    def_bool $(shields_list_contains,nijuni_left)
    select SHIELD_NIJUNI

config SHIELD_NIJUNI_RIGHT
    def_bool $(shields_list_contains,nijuni_right)
    select SHIELD_NIJUNI
```

## config/west.yml
```yaml
manifest:
  remotes:
    - name: zmkfirmware
      url-base: https://github.com/zmkfirmware
    - name: badjeff
      url-base: https://github.com/badjeff
  projects:
    - name: zmk
      remote: zmkfirmware
      revision: v0.3
      import: app/west.yml
    - name: zmk-behavior-mouse-key-toggle
      remote: badjeff
      revision: 4ad250241b1a90acfdd01d363f91e5336f9744fc
  self:
    path: config
```
