&spi1 {
    status = "disabled";
    sck-pin = <27>;         // SCL → P0.27
    mosi-pin = <26>;        // SDA → P0.26
    cs-gpios = <&gpio0 6 GPIO_ACTIVE_LOW>;  // твой CS = P0.06 (верхний правый)
};

&display {
    status = "disabled";
    compatible = "zmk,nice-view";
    spi-max-frequency = <1000000>;
    reg = <0>;
    width = <160>;
    height = <68>;
    segment-offset = <1>;
    page-offset = <0>;
    rotation = <0>;
};
