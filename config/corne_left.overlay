/*
 * RT-22 v0.2 Final Corrected Overlay
 * 
 * Based on silkscreen and Pro Micro (nice!nano) pin standards:
 * F6 = 19, F7 = 18, B1 = 15, B3 = 14
 * SCL = 3, SDA = 2, D4 = 4, C6 = 5, D7 = 6, E6 = 7
 */

/ {
    chosen {
        zmk,kscan = &kscan0;
    };

    kscan0: kscan {
        compatible = "zmk,kscan-gpio-matrix";
        wakeup-source;
        diode-direction = "col2row";

        row-gpios
            = <&pro_micro 19 (GPIO_ACTIVE_HIGH | GPIO_PULL_DOWN)> /* F6 */
            , <&pro_micro 18 (GPIO_ACTIVE_HIGH | GPIO_PULL_DOWN)> /* F7 */
            , <&pro_micro 15 (GPIO_ACTIVE_HIGH | GPIO_PULL_DOWN)> /* B1 */
            , <&pro_micro 14 (GPIO_ACTIVE_HIGH | GPIO_PULL_DOWN)> /* B3 */
            ;

        col-gpios
            = <&pro_micro 3 GPIO_ACTIVE_HIGH> /* SCL Silk - Dummy Col 0 */
            , <&pro_micro 2 GPIO_ACTIVE_HIGH> /* SDA Silk - QAZ Col 1 */
            , <&pro_micro 4 GPIO_ACTIVE_HIGH> /* D4 Silk  - WSX Col 2 */
            , <&pro_micro 5 GPIO_ACTIVE_HIGH> /* C6 Silk  - EDC Col 3 */
            , <&pro_micro 6 GPIO_ACTIVE_HIGH> /* D7 Silk  - RFV Col 4 */
            , <&pro_micro 7 GPIO_ACTIVE_HIGH> /* E6 Silk  - TGB Col 5 */
            ;
    };
};

/* Ensure I2C is disabled to free pins 2 and 3 */
&pro_micro_i2c {
    status = "disabled";
};
